## boards/arm/waveshare_rp2040_zero/Kconfig.defconfig
```kconfig
# Copyright (c) 2024 The ZMK Contributors
# SPDX-License-Identifier: Apache-2.0

if BOARD_WAVESHARE_RP2040_ZERO

config BOARD
	default "waveshare_rp2040_zero"

config RP2_FLASH_W25Q080
	default y


# Enable ZMK USB HID
CONFIG_ZMK_USB=y
CONFIG_ZMK_USB_HID=y

# RP2040 uses TinyUSB backend
CONFIG_USB_DC_NRF=n
CONFIG_USB_DC_NATIVE_POSIX=n
CONFIG_USB_DC_STM32=n
CONFIG_USB_DC_RP2040=y

CONFIG_BT=n
CONFIG_BT_CTLR=n
CONFIG_BT_HCI=n
CONFIG_BT_PERIPHERAL=n
CONFIG_BT_HCI_RAW=n
CONFIG_BT_BREDR=n
CONFIG_ZMK_BLE=n
	
endif # BOARD_WAVESHARE_RP2040_ZERO
```
